#include "android.dtsi"
#include "ramoops.dtsi"
#include "soc.dtsi"
#include "misc.dtsi"
#include "audio.dtsi"
#include "display.dtsi"
#include "haptic.dtsi"
#include "regulator.dtsi"
#include "leds.dtsi"