#include "../common/sdhc.dtsi"
#include "../common/spi.dtsi"
#include "../common/pinctrl.dtsi"
#include "display.dtsi"
#include "camera.dtsi"
#include "battery.dtsi"
#include "audio.dtsi"
#include "misc.dtsi"
#include "fingerprint.dtsi"