/* msm-audio */
&int_codec {
	qcom,msm-hs-micbias-type = "internal";
};

&soc {
	i2c@78b6000 {
		status = "okay";
		spkamp@3a {/* max98927 smartpa device*/
			compatible = "maxim,max98927L";
			status = "okay";
			reg = <0x3a>;
			mono_stereo_mode = <0>;
			interleave_mode = <0>;
			vmon-l-slot = <1>;
			imon-l-slot = <1>;
			vmon-r-slot = <1>;
			imon-r-slot = <1>;
			maxim,98927-reset-gpio = <&tlmm 89 0>;
		};
	};
};