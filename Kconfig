## Kconfig
```kconfig
config MACH_XIAOMI_TITANIUM
	bool "Support for Xiaomi MSM8953 platform"
	help
	  Say Y here to enable support for Xiaomi MSM8953 platform.

source "techpack/xiaomi-titanium/mach/Kconfig"
source "techpack/xiaomi-titanium/pmic/Kconfig"
source "techpack/xiaomi-titanium/power_supply/Kconfig"
source "techpack/xiaomi-titanium/touchscreen/Kconfig"
source "techpack/xiaomi-titanium/ir/Kconfig"
source "techpack/xiaomi-titanium/leds/Kconfig"
source "techpack/xiaomi-titanium/fingerprint/Kconfig"
source "techpack/xiaomi-titanium/vibrator/Kconfig"
```

## mach/Kconfig
```kconfig
# Machine families
config MACH_FAMILY_XIAOMI_MTP
	bool

config MACH_FAMILY_XIAOMI_QRD
	bool

config MACH_FAMILY_XIAOMI_QRD_SDM450
	bool
	depends on ARCH_SDM450
	select MACH_FAMILY_XIAOMI_QRD

config MACH_FAMILY_XIAOMI_QRD_MSM8953
	bool
	depends on ARCH_MSM8953
	select MACH_FAMILY_XIAOMI_QRD

# Machines
config MACH_XIAOMI_MSM8953
	bool "Xiaomi MSM8953"
	help
	  Support for Xiaomi MSM8953.

config MACH_XIAOMI_ROSY
	bool "Xiaomi Redmi 5 (rosy)"
	select MACH_FAMILY_XIAOMI_QRD_SDM450
	help
	  Support for Xiaomi Redmi 5 (rosy).

config MACH_XIAOMI_VINCE
	bool "Xiaomi Redmi 5 Plus (vince)"
	depends on ARCH_MSM8953
	select MACH_FAMILY_XIAOMI_QRD_MSM8953
	help
	  Support for Xiaomi Redmi 5 Plus (vince).

config MACH_XIAOMI_SAKURA
	bool "Xiaomi Redmi 6 Pro (sakura)"
	depends on ARCH_MSM8953
	select MACH_FAMILY_XIAOMI_QRD_MSM8953
	help
	  Support for Xiaomi Redmi 6 Pro (sakura).

config MACH_XIAOMI_TISSOT
	bool "Xiaomi Mi a1 (tissot)"
	depends on ARCH_MSM8953
	select MACH_FAMILY_XIAOMI_QRD_MSM8953
	help
	  Support for Xiaomi Mi a1 (tissot).

config MACH_XIAOMI_MIDO
	bool "Xiaomi Redmi 4 (mido)"
	help
	  Support for Xiaomi Redmi 4 (mido).

config MACH_XIAOMI_YSL
	bool "Xiaomi Redmi S2 / Y2 (ysl)"
	depends on ARCH_MSM8953
	select MACH_FAMILY_XIAOMI_MTP
	help
	  Support for Xiaomi Redmi S2 / Y2 (ysl).
```

## power_supply/qcom/Kconfig
```kconfig
config QPNP_FG_MI8953
	tristate "QPNP fuel gauge driver"
	depends on MFD_SPMI_PMIC
	help
	  Say Y here to enable the Fuel Gauge driver. This adds support for
	  battery fuel gauging and state of charge of battery connected to the
	  fuel gauge. The state of charge is reported through a BMS power
	  supply property and also sends uevents when the capacity is updated.

config QPNP_SMBCHARGER_MI8953
	tristate "QPNP SMB Charger driver"
	depends on MFD_SPMI_PMIC
	help
	  Say Y here to enable the dual path switch mode battery charger which
	  supports USB detection and battery charging up to 3A.
	  The driver also offers relevant information to userspace via the
	  power supply framework.

config QPNP_TYPEC
	tristate "QPNP Type-C driver"
	depends on MFD_SPMI_PMIC
	help
	  Say Y here to enable QPNP Type-C driver.
	  The QPNP Type-C module supports the USB type-C protocol. It supports
	  type-C cable detection and other type-C parameters such as
	  current-capability and CC-orientation. The module does not support
	  USB power-delivery. The driver adds support to report these type-C
	  parameters via the power-supply framework.
```
